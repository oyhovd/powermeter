## prj.conf
```kconfig
CONFIG_BT=y
CONFIG_BT_DEBUG_LOG=y
CONFIG_BT_SMP=y
CONFIG_BT_PERIPHERAL=y
CONFIG_BT_DEVICE_NAME="kW power"
CONFIG_BT_DEVICE_APPEARANCE=833

CONFIG_FLASH=y
CONFIG_SOC_FLASH_NRF5=y
CONFIG_SOC_FLASH_NRF5_DEV_NAME="NRF5_FLASH"
CONFIG_SOC_FLASH_NRF5_RADIO_SYNC=y
```

## src/main.c
```c
/* main.c - Application main entry point */

/*
 * Copyright (c) 2015-2016 Intel Corporation
 * Modification copyright (c) 2017 Oyvind Hovdsveen
 *
 * SPDX-License-Identifier: Apache-2.0
 */

#include <zephyr/types.h>
#include <stddef.h>
#include <string.h>
#include <stdio.h>
#include <errno.h>
#include <misc/printk.h>
#include <misc/byteorder.h>
#include <zephyr.h>

#include <bluetooth/bluetooth.h>
#include <bluetooth/conn.h>
#include <bluetooth/uuid.h>

#include "powermeter.h"

#define M_ITERATION_TIME_MS (10)
#define M_ADV_UPDATE_TIME_MS (5000)

#define DEVICE_NAME		CONFIG_BT_DEVICE_NAME
#define DEVICE_NAME_LEN		(sizeof(DEVICE_NAME) - 1)

struct bt_conn *default_conn;

static const struct bt_data ad[] = {
    BT_DATA_BYTES(BT_DATA_FLAGS, (BT_LE_AD_GENERAL | BT_LE_AD_NO_BREDR)),
};

static const struct bt_data sd[] = {
    BT_DATA(BT_DATA_NAME_COMPLETE, DEVICE_NAME, DEVICE_NAME_LEN),
};

static void connected(struct bt_conn *conn, u8_t err)
{
    if (err) {
        printk("Connection failed (err %u)\n", err);
    } else {
        default_conn = bt_conn_ref(conn);
        printk("Connected\n");
    }
}

static void disconnected(struct bt_conn *conn, u8_t reason)
{
    printk("Disconnected (reason %u)\n", reason);

    if (default_conn) {
        bt_conn_unref(default_conn);
        default_conn = NULL;
    }
}

static struct bt_conn_cb conn_callbacks = {
    .connected = connected,
    .disconnected = disconnected,
};

static void bt_ready(int err)
{
    if (err) {
        printk("Bluetooth init failed (err %d)\n", err);
        return;
    }

    printk("Bluetooth initialized\n");

    err = bt_le_adv_start(BT_LE_ADV_CONN, ad, ARRAY_SIZE(ad),
            sd, ARRAY_SIZE(sd));
    if (err) {
        printk("Advertising failed to start (err %d)\n", err);
        return;
    }

    printk("Advertising successfully started\n");
}

static void auth_cancel(struct bt_conn *conn)
{
    char addr[BT_ADDR_LE_STR_LEN];

    bt_addr_le_to_str(bt_conn_get_dst(conn), addr, sizeof(addr));

    printk("Pairing cancelled: %s\n", addr);
}

static struct bt_conn_auth_cb auth_cb_display = {
    .cancel = auth_cancel,
};

//Restarts advertising, uses the latest power stats in the device name
void adv_update(void)
{
    //Check if it is time
    static u32_t last_time = 0;
    u32_t now = k_uptime_get_32();

    if((s32_t)(now - last_time) > M_ADV_UPDATE_TIME_MS)
    {
        last_time += M_ADV_UPDATE_TIME_MS;

        bt_le_adv_stop();

        u32_t last_min = pm_last_time_avg_pow_get(60);
        u32_t last_twenty = pm_last_time_avg_pow_get(60*20);
        u32_t last_hour = pm_last_time_avg_pow_get(60*60);

        if(last_min >= 100000)
        {
            last_min = 99999;
        }

        if(last_twenty >= 100000)
        {
            last_twenty = 9999; } if(last_hour >= 100000) {
                last_hour = 99999;
            }

        char name[30];
        //kW xx.xxx xx.xxx xx.xxx
        uint32_t size = snprintf(name,
                sizeof(name),
                "kW %d.%03d %d.%03d %d.%03d",
                last_min/1000,
                last_min%1000,
                last_twenty/1000,
                last_twenty%1000,
                last_hour/1000,
                last_hour%1000);
        struct bt_data scandata[] = {
            BT_DATA(BT_DATA_NAME_COMPLETE, name, size),
        };

        bt_le_adv_start(BT_LE_ADV_CONN, ad, ARRAY_SIZE(ad),
                scandata, ARRAY_SIZE(scandata));
    }
}

void main(void)
{
    int err;

    err = bt_enable(bt_ready);
    if (err) {
        printk("Bluetooth init failed (err %d)\n", err);
        return;
    }

    bt_conn_cb_register(&conn_callbacks);
    bt_conn_auth_cb_register(&auth_cb_display);

    pm_init();

    u64_t next_up = 0;
    while (1) {
        //Spin until next iteration
        while(1)
        {
            u32_t now = k_uptime_get_32();
            s32_t time_to_sleep = next_up - now;
            if(time_to_sleep > 0)
            {
                k_sleep(time_to_sleep);
            }
            else
            {
                break;
            }
        }
        next_up += M_ITERATION_TIME_MS;

        pm_blink_count_update();

        adv_update();
    }
}
```

## src/powermeter.c
```c
/* powermeter.c - Functions for reading and parsing the blinking on the utility meter */

/*
 * Copyright (c) 2017 Oyvind Hovdsveen
 *
 * Licensed under the Apache License, Version 2.0 (the "License");
 * you may not use this file except in compliance with the License.
 * You may obtain a copy of the License at
 *
 *     http://www.apache.org/licenses/LICENSE-2.0
 *
 * Unless required by applicable law or agreed to in writing, software
 * distributed under the License is distributed on an "AS IS" BASIS,
 * WITHOUT WARRANTIES OR CONDITIONS OF ANY KIND, either express or implied.
 * See the License for the specific language governing permissions and
 * limitations under the License.
 */

#include "powermeter.h"

#include "nrf_adc.h"

#include <zephyr/types.h>
#include <device.h>
#include <flash.h>
#include <stddef.h>
#include <string.h>
#include <errno.h>
#include <misc/printk.h>
#include <misc/byteorder.h>
#include <zephyr.h>


//Uncomment to get some faked measurements
//#define SIMULATE
//#define FAST
//#define EXTRA_FAST

#ifdef FAST
#define FAST_MULTIPLIER (60)
#else
#define FAST_MULTIPLIER (1)
#endif

#ifdef EXTRA_FAST
#define EXTRA_FAST_MULTIPLIER (100)
#else
#define EXTRA_FAST_MULTIPLIER (1)
#endif

#define M_SAMPLE_INTERVAL_MS (10) //100Hz
#define M_TAU (128) //In samples
#define M_TAU_M (M_TAU-1)
#define M_FP_SHIFT (32)
#define M_DEBOUNCE_MS (50)
#define M_BLINK_TIMEOUT_MS (5*M_DEBOUNCE_MS)
#define M_INIT_TIME_MS (M_SAMPLE_INTERVAL_MS*M_TAU*4) //4 time constants should get us close
#define M_SECS_SLOT (60/FAST_MULTIPLIER)  //Seconds per slot in the array below. Let it be a factor in 60
#define M_SECS_HOUR (3600)

#define M_FLASH_FIRST_PAGE (0x20000)
#define M_FLASH_PAGE_SIZE (1024)
#define M_FLASH_WORDS_RESERVED (64*(M_FLASH_PAGE_SIZE/sizeof(u32_t)))
#define M_EMPTY_FLASH_WORD (0xFFFFFFFF)

typedef enum
{
    M_SAMPLER_UNINIT,
    M_SAMPLER_DARK,
    M_SAMPLER_LIGHT_DEBOUNCE,
    M_SAMPLER_LIGHT,
    M_SAMPLER_DARK_DEBOUNCE,
} m_sampler_state_t;

static u8_t m_sample_get(void);
static void m_slot_update(void);
static void m_update_flash_store(u32_t data);

//Kept static for debugging purposes
static u64_t m_moving_avg;
static u32_t m_meas = 0;
static const u32_t m_flash_page_pointer = M_FLASH_FIRST_PAGE;
u32_t (*m_flash_array)[M_FLASH_WORDS_RESERVED];// = (u32_t (const *)[M_FLASH_WORDS_RESERVED])m_flash_page_pointer;
static u32_t m_next_word_to_write = 0;


//Returns 1 if a blink is detected. Can be called at any time, but must be
//called often enough (at least every M_SAMPLE_INTERVAL_MS)
static u8_t m_sample_get(void)
{
    static m_sampler_state_t state = M_SAMPLER_UNINIT;
    static u64_t next_action_uptime = 0; //Assume this never wraps
    static u64_t state_entered = 0;

    u64_t now = k_uptime_get();

    if(now < next_action_uptime)
    {
        return 0;
    }

    if(next_action_uptime == 0)
    {
        //First call, update next_action_uptime.
        next_action_uptime = now;
        //Initial state
        state = M_SAMPLER_UNINIT;
        state_entered = now;
    }
    next_action_uptime += M_SAMPLE_INTERVAL_MS;

#ifdef SIMULATE
    static u8_t rand_byte;
    rand_byte = (rand_byte + 19);
    u8_t sample_8;
    if(rand_byte > 220)
    {
        sample_8 = 0;
    }
    else
    {
        sample_8 = 255;
    }
    u64_t sample = (u64_t)rand_byte << M_FP_SHIFT;
#else
    u64_t sample = (u64_t)nrf_adc_convert_single(NRF_ADC_CONFIG_INPUT_2) << M_FP_SHIFT;
#endif
    m_moving_avg = (m_moving_avg*M_TAU_M)/M_TAU;
    m_moving_avg += sample/M_TAU;

    switch(state)
    {
        case M_SAMPLER_UNINIT:
            if(now - state_entered >= M_INIT_TIME_MS)
            {
                //Stay here for a while to tune the moving avg
                state = M_SAMPLER_DARK;
                state_entered = now;
            }
            break;

        case M_SAMPLER_DARK:
            if(sample < (2*m_moving_avg)/3)
            {
                //We detected light
                state = M_SAMPLER_LIGHT_DEBOUNCE;
                state_entered = now;
            }
            break;

        case M_SAMPLER_LIGHT_DEBOUNCE:
            if(now - state_entered >= M_DEBOUNCE_MS)
            {
                //Debounce done
                state = M_SAMPLER_LIGHT;
                state_entered = now;
            }
            break;

        case M_SAMPLER_LIGHT:
            if(now - state_entered >= M_BLINK_TIMEOUT_MS)
            {
                //Timeout waiting for light to turn off.
                state = M_SAMPLER_DARK;
                state_entered = now;
            }
            else if(sample >= (2*m_moving_avg)/3)
            {
                //We detected dark
                state = M_SAMPLER_DARK_DEBOUNCE;
                state_entered = now;
            }
            break;

        case M_SAMPLER_DARK_DEBOUNCE:
            if(now - state_entered >= M_DEBOUNCE_MS)
            {
                //Debounce done
                state = M_SAMPLER_DARK;
                state_entered = now;

                return 1; //Count the blink
            }
            break;

        default:
            printk("Invalid state");
            while(1);
    }
    return 0;
}

static void m_slot_update(void)
{
    //Write flash if a new slot has started
    u32_t current_second = (u32_t)(k_uptime_get()/(1000/EXTRA_FAST_MULTIPLIER));
    static u32_t prev_slot = 0;
    u32_t current_slot = (current_second/M_SECS_SLOT) % (M_FLASH_WORDS_RESERVED);
    if(prev_slot != current_slot)
    {
        m_update_flash_store(m_meas);
        prev_slot = current_slot;
        m_meas=0;
    }
}

static void m_update_flash_store(u32_t data)
{
    if(data == M_EMPTY_FLASH_WORD)
    {
        data--;
    }

    u32_t offset = (u32_t)m_flash_page_pointer + m_next_word_to_write*sizeof(u32_t);
    //Enable writing and write the word
    struct device *flash_dev;
    flash_dev = device_get_binding(CONFIG_SOC_FLASH_NRF5_DEV_NAME);
    flash_write_protection_set(flash_dev, false);
    if (flash_write(flash_dev, offset, &data,
                sizeof(data)) != 0) {
        while(1);
    }
    flash_write_protection_set(flash_dev, true);

    m_next_word_to_write++;
    if(m_next_word_to_write == M_FLASH_WORDS_RESERVED)
    {
        //wraparound
        m_next_word_to_write = 0;
    }
    //The word after the next must be empty. If not, the page must be
    //erased.
    u32_t next_empty_word = m_next_word_to_write + 1;
    if(next_empty_word == M_FLASH_WORDS_RESERVED)
    {
        //wraparound
        next_empty_word = 0;
    }

    if((*m_flash_array)[next_empty_word] != M_EMPTY_FLASH_WORD)
    {
        offset = (u32_t)m_flash_page_pointer + next_empty_word*sizeof(u32_t);
        //Find start of page
        offset = M_FLASH_PAGE_SIZE * (offset/M_FLASH_PAGE_SIZE);

        flash_write_protection_set(flash_dev, false);
        if (flash_erase(flash_dev, offset, M_FLASH_PAGE_SIZE) != 0) {
            while(1);
        }
        flash_write_protection_set(flash_dev, true);
    }
}

void pm_init(void)
{
    nrf_adc_config_t config = {
        .resolution = NRF_ADC_CONFIG_RES_8BIT,
        .scaling = NRF_ADC_CONFIG_SCALING_INPUT_FULL_SCALE,
        .reference = NRF_ADC_CONFIG_REF_VBG,
    };
    m_flash_array = (u32_t (*)[M_FLASH_WORDS_RESERVED])m_flash_page_pointer;
    nrf_adc_configure(&config);

    //find next word to write
    bool found_existing = false;
    u32_t i;
    for(i = 0; i < M_FLASH_WORDS_RESERVED; i++)
    {
        if((*m_flash_array)[i] != M_EMPTY_FLASH_WORD)
        {
            found_existing = true;
        }
        if(found_existing && ((*m_flash_array)[i] == M_EMPTY_FLASH_WORD))
        {
            break;
        }
    }

    //If not found anything
    if(i == M_FLASH_WORDS_RESERVED)
    {
        m_next_word_to_write = 0;
    }
    else
    {
        m_next_word_to_write = i;
    }

    //erase if needed
    if((*m_flash_array)[m_next_word_to_write] != M_EMPTY_FLASH_WORD)
    {
        u32_t offset = (u32_t)m_flash_page_pointer + m_next_word_to_write*sizeof(u32_t);
        //Find start of page
        offset = M_FLASH_PAGE_SIZE * (offset/M_FLASH_PAGE_SIZE);

        struct device *flash_dev;
        flash_dev = device_get_binding(CONFIG_SOC_FLASH_NRF5_DEV_NAME);
        flash_write_protection_set(flash_dev, false);
        if (flash_erase(flash_dev, offset, M_FLASH_PAGE_SIZE) != 0) {
            while(1);
        }
        flash_write_protection_set(flash_dev, true);
    }
}

void pm_blink_count_update(void)
{
    m_slot_update();
    u8_t sample = m_sample_get();
    m_meas += sample;
}

u8_t pm_moving_avg_get(void)
{
    return m_moving_avg >> M_FP_SHIFT;
}

u32_t pm_last_time_avg_pow_get(u32_t secs)
{
    u32_t blinks = 0;
    for(u32_t i = 0; i < secs/M_SECS_SLOT; i++)
    {
        //Get the data from previous slot and before
        u32_t word = (m_next_word_to_write-1-i) % M_FLASH_WORDS_RESERVED;
        u32_t value = (*m_flash_array)[word];
        if(value == M_EMPTY_FLASH_WORD)
        {
            value = 0;
        }
        blinks+=value;
    }

    return (M_SECS_HOUR*blinks)/secs;
}

u8_t pm_blink_count_get(void)
{
    return m_meas;
}
```

## src/powermeter.h
```c
/* powermeter.h - Functions for reading and parsing the blinking on the utility meter */

/*
 * Copyright (c) 2017 Oyvind Hovdsveen
 *
 * Licensed under the Apache License, Version 2.0 (the "License");
 * you may not use this file except in compliance with the License.
 * You may obtain a copy of the License at
 *
 *     http://www.apache.org/licenses/LICENSE-2.0
 *
 * Unless required by applicable law or agreed to in writing, software
 * distributed under the License is distributed on an "AS IS" BASIS,
 * WITHOUT WARRANTIES OR CONDITIONS OF ANY KIND, either express or implied.
 * See the License for the specific language governing permissions and
 * limitations under the License.
 */

#include <zephyr/types.h>

void pm_init(void);
void pm_blink_count_update(void);
u8_t pm_moving_avg_get(void);
u32_t pm_last_time_avg_pow_get(u32_t secs);
u8_t pm_blink_count_get(void);
```
